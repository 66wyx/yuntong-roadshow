## hardware/rid-handheld-evt1/firmware/c5/main/Kconfig.projbuild
```kconfig
menu "RID EVT1 C5 receiver"
config EVT1_ENABLE_WIFI_CAPTURE
    bool "Enable passive Wi-Fi capture on reviewed receiver hardware"
    default n
config EVT1_WIFI_CHANNEL
    int "Capture channel (6 for initial 2.4 GHz, 149 for initial 5.8 GHz)"
    range 1 165
    default 6
config EVT1_COUNTRY_CODE
    string "Deployment Wi-Fi country code"
    default "CN"
endmenu
```

## hardware/rid-handheld-evt1/firmware/c5/sdkconfig.defaults
```kconfig
CONFIG_IDF_TARGET="esp32c5"
CONFIG_ESPTOOLPY_FLASHSIZE_8MB=y
CONFIG_ESP_CONSOLE_USB_SERIAL_JTAG=y
CONFIG_ESP_CONSOLE_SECONDARY_NONE=y
CONFIG_EVT1_ENABLE_WIFI_CAPTURE=n
CONFIG_EVT1_WIFI_CHANNEL=6
CONFIG_EVT1_COUNTRY_CODE="CN"
```

## hardware/rid-handheld-evt1/firmware/p4/main/Kconfig.projbuild
```kconfig
menu "RID receiver"

    config RID_CAPTURE_CHANNEL
        int "2.4 GHz capture channel"
        default 6
        range 1 13
        help
            Channel 6 is the RID Beacon default. A Windows Wi-Fi Direct
            bench transmitter chooses its own channel (11 on the tested
            MT7612U); set this to match it.

    config RID_SCAN_DWELL_MS
        int "Channel hop dwell time (ms, 0 = stay on the capture channel)"
        default 0
        range 0 5000
        help
            0 stays on RID_CAPTURE_CHANNEL. A non-zero value hops
            1 -> 6 -> 11, staying this long on each, to find a source on
            an unknown channel. Each hop is an SDIO round trip to the C6,
            so frames are lost while hopping; use it only to locate a
            source, then fix the channel.

    config RID_DEBUG_WATCH_MAC
        string "Log every management frame from this MAC (bench debug)"
        default ""
        help
            Colon-separated MAC address, for example 06:13:ef:3f:65:d5.
            Matching Beacons and Probe Responses are printed as RID_WATCH
            lines with channel, RSSI and element IDs, whether or not they
            carry RID. Leave empty to disable.

endmenu
```

## hardware/rid-handheld-evt1/firmware/p4/sdkconfig.defaults
```kconfig
CONFIG_IDF_TARGET="esp32p4"
CONFIG_SPIRAM=y
CONFIG_SPIRAM_MODE_HEX=y
CONFIG_SPIRAM_SPEED_200M=y
CONFIG_ESPTOOLPY_FLASHSIZE_8MB=y
CONFIG_PARTITION_TABLE_CUSTOM=y
CONFIG_PARTITION_TABLE_CUSTOM_FILENAME="partitions.csv"
CONFIG_COMPILER_OPTIMIZATION_PERF=y
CONFIG_IDF_EXPERIMENTAL_FEATURES=y
CONFIG_FREERTOS_HZ=1000
CONFIG_ESP_WIFI_REMOTE_LIBRARY_HOSTED=y
CONFIG_ESP_HOSTED_SDIO_HOST_INTERFACE=y
CONFIG_ESP_HOSTED_SDIO_CLOCK_FREQ_KHZ=40000
CONFIG_ESP_HOSTED_SDIO_BUS_WIDTH=4
CONFIG_ESP_HOSTED_SDIO_TX_Q_SIZE=60
CONFIG_ESP_HOSTED_SDIO_RX_Q_SIZE=60
CONFIG_ESP_HOSTED_ENABLE_PEER_DATA_TRANSFER=y
CONFIG_ESP_HOSTED_MAX_CUSTOM_MSG_HANDLERS=8
CONFIG_ESP_TASK_WDT_EN=n
CONFIG_ESP_INT_WDT=n
CONFIG_LOG_DEFAULT_LEVEL_INFO=y
CONFIG_LOG_MAXIMUM_LEVEL_VERBOSE=y
```

## hardware/rid-handheld-evt1/firmware/s3/main/Kconfig.projbuild
```kconfig
menu "RID EVT1 bringup"
config EVT1_BOARD_REVIEWED
    bool "Enable board outputs after schematic and power review"
    default n
    help
        With this off, firmware only exports honest health/status and does not
        enable radio rails or configure unreviewed board outputs.
endmenu
```

## hardware/rid-handheld-evt1/firmware/s3/sdkconfig.defaults
```kconfig
CONFIG_IDF_TARGET="esp32s3"
CONFIG_ESPTOOLPY_FLASHSIZE_16MB=y
CONFIG_SPIRAM=y
CONFIG_SPIRAM_MODE_OCT=y
CONFIG_ESP_CONSOLE_UART_DEFAULT=y
CONFIG_ESP_CONSOLE_SECONDARY_NONE=y
CONFIG_COMPILER_CXX_EXCEPTIONS=n
CONFIG_EVT1_BOARD_REVIEWED=n
```
